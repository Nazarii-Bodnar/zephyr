## prj.conf
```kconfig
# Copyright (c) 2025 Telink Semiconductor
# SPDX-License-Identifier: Apache-2.0

CONFIG_NETWORKING=y
CONFIG_WIFI=y
CONFIG_NET_L2_OPENTHREAD=y
CONFIG_NET_IF_MAX_IPV6_COUNT=2

# CONFIG_NET_PKT_TXTIME=y
# CONFIG_NET_PKT_TIMESTAMP=y

# Thread v1.3 features
CONFIG_OPENTHREAD_THREAD_VERSION_1_3=y
CONFIG_OPENTHREAD_SRP_CLIENT=y
CONFIG_OPENTHREAD_JOINER=y
CONFIG_OPENTHREAD_LINK_METRICS_SUBJECT=y
CONFIG_OPENTHREAD_BORDER_ROUTER=y
CONFIG_OPENTHREAD_COMMISSIONER=y
CONFIG_OPENTHREAD_PING_SENDER=y
CONFIG_OPENTHREAD_DHCP6_CLIENT=y
CONFIG_OPENTHREAD_DNS_CLIENT=y
CONFIG_OPENTHREAD_SLAAC=y
CONFIG_OPENTHREAD_REFERENCE_DEVICE=y
CONFIG_OPENTHREAD_MLR=y
CONFIG_OPENTHREAD_MAC_FILTER=y
CONFIG_OPENTHREAD_DUA=y
CONFIG_OPENTHREAD_COAP=y
CONFIG_OPENTHREAD_COAPS=y
CONFIG_MBEDTLS_PEM_CERTIFICATE_FORMAT=y
CONFIG_OPENTHREAD_ENABLE_SERVICE=y
CONFIG_OPENTHREAD_NUM_MESSAGE_BUFFERS=350
CONFIG_OPENTHREAD_CSL_RECEIVE_TIME_AHEAD=480

# Logging & shell
CONFIG_LOG=y
CONFIG_SHELL_VT100_COMMANDS=n
CONFIG_NET_SHELL=y
CONFIG_NET_L2_WIFI_SHELL=y
CONFIG_OPENTHREAD_SHELL=y
CONFIG_OPENTHREAD_MANUAL_START=y
CONFIG_SHELL_DEFAULT_TERMINAL_WIDTH=640
CONFIG_SHELL_CMD_BUFF_SIZE=640
CONFIG_OPENTHREAD_CLI_MAX_LINE_LENGTH=640

# thread network credentials
CONFIG_OPENTHREAD_CHANNEL=18
# 0x1418 = 5144
CONFIG_OPENTHREAD_PANID=5144
CONFIG_OPENTHREAD_XPANID="00:0d:b8:00:00:00:00:00"
CONFIG_OPENTHREAD_NETWORKKEY="ff:11:22:33:44:55:66:77:88:99:aa:bb:cc:dd:ee:ff"

CONFIG_COMMON_LIBC_MALLOC_ARENA_SIZE=12288
```

## boards/tlsr9118bdk40d_v1.conf
```kconfig
# Copyright (c) 2025 Telink Semiconductor
# SPDX-License-Identifier: Apache-2.0
```

## src/main.c
```c
/*
 * Copyright (c) 2025 Telink
 *
 * SPDX-License-Identifier: Apache-2.0
 */

#include <zephyr/logging/log.h>
LOG_MODULE_REGISTER(net_main, LOG_LEVEL_DBG);

int main(void)
{
	LOG_INF("***** Network CLI on Zephyr *****");

	return 0;
}
```
